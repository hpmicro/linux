## Documentation/devicetree/bindings/gpio/hpmicro,gpio.yaml
```yaml
# SPDX-License-Identifier: (GPL-2.0 OR BSD-2-Clause)
%YAML 1.2
---

title: HPMicro GPIO controller

properties:
  compatible:
    items:
      - enum:
          - hpmicro,gpio

  reg:
    description: The GPIO Controller's base address
    maxItems: 1

  n-ports:
    description:
      The number of GPIO Ports available on the controller.
    minimum: 1
    maximum: 9
    default: 6

required:
  - compatible
  - reg
  - n-ports

patternProperties:
  "(^gpio_port[a-z]$|^gpio_port[a-z]$)":
    type: object
    $ref: common.yaml#
    unevaluatedProperties: false

    properties:
      compatible:
        items:
          - enum:
              - hpmicro,gpio-port
      reg:
        description:
          The index of the port. 0 for PA and 1 for PB and so on.
        maxItems: 1

      ngpios:
        description:
          The pin number of the port.
        minimum: 1
        maximum: 32
        default: 32

      gpio-ranges:
        minimum: 0
        maximum: 288

      interrupts:
        maxItems: 1

      interrupt-controller: true

      gpio-controller: true

      "#interrupt-cells":
        const: 2

      "#gpio-cells":
        const: 2

    required:
      - compatible
      - reg
      - ngpios
      - gpio-ranges
      - interrupts
      - interrupt-controller
      - gpio-controller
      - "#interrupt-cells"
      - "#gpio-cells"

examples:
  - |
      #include <dt-bindings/gpio/gpio.h>
      gpio0: gpio-controller@f00d0000 {
        #address-cells = <1>;
        #size-cells = <0>;
        compatible = "hpmicro,gpio";
        reg = <0xF00D0000 0x4000>;
        n-ports = <6>;
        status = "okay";
        gpio_porta: gpio-porta@0 {
          #gpio-cells = <2>;
          #interrupt-cells = <2>;
          compatible = "hpmicro,gpio-port";
          reg = <0>;
          interrupt-controller;
          interrupts = <1>;
          gpio-controller;
          ngpios = <32>;
          gpio-ranges = <&ioc 0 0 32>;
        };
      };

...
```

## arch/riscv/configs/nommu_hpmicro_defconfig
```kconfig
CONFIG_LOG_BUF_SHIFT=16
# CONFIG_INITRAMFS_PRESERVE_MTIME is not set
CONFIG_CC_OPTIMIZE_FOR_SIZE=y
CONFIG_EXPERT=y
# CONFIG_MULTIUSER is not set
# CONFIG_SYSFS_SYSCALL is not set
# CONFIG_FHANDLE is not set
CONFIG_BASE_SMALL=y
# CONFIG_FUTEX is not set
# CONFIG_EPOLL is not set
# CONFIG_SIGNALFD is not set
# CONFIG_TIMERFD is not set
# CONFIG_EVENTFD is not set
# CONFIG_AIO is not set
# CONFIG_IO_URING is not set
# CONFIG_ADVISE_SYSCALLS is not set
# CONFIG_KALLSYMS is not set
# CONFIG_RISCV_M_MODE is not set
# CONFIG_MMU is not set
CONFIG_PAGE_OFFSET_BOOL=y
CONFIG_PAGE_OFFSET=0x40000000
CONFIG_ARCH_HPMICRO=y
CONFIG_NONPORTABLE=y
CONFIG_ARCH_RV32I=y
CONFIG_CMODEL_MEDANY=y
# CONFIG_RISCV_ISA_ZBB is not set
# CONFIG_RISCV_ISA_ZICBOZ is not set
# CONFIG_FPU is not set
CONFIG_RISCV_SBI_V01=y
CONFIG_CMDLINE="root=/dev/vda rw earlycon=sbi console=sbi ignore_loglevel"
CONFIG_JUMP_LABEL=y
# CONFIG_COMPAT_32BIT_TIME is not set
# CONFIG_BLK_DEV_WRITE_MOUNTED is not set
# CONFIG_BLK_DEBUG_FS is not set
# CONFIG_MQ_IOSCHED_DEADLINE is not set
# CONFIG_MQ_IOSCHED_KYBER is not set
# CONFIG_BINFMT_ELF_FDPIC is not set
CONFIG_BINFMT_FLAT=y
# CONFIG_COREDUMP is not set
# CONFIG_COMPAT_BRK is not set
CONFIG_MMAP_ALLOW_UNINITIALIZED=y
CONFIG_DEVTMPFS=y
CONFIG_DEVTMPFS_MOUNT=y
# CONFIG_FW_LOADER is not set
# CONFIG_ALLOW_DEV_COREDUMP is not set
CONFIG_MTD=y
CONFIG_MTD_BLOCK=y
CONFIG_MTD_ROM=y
CONFIG_MTD_PHYSMAP=y
CONFIG_MTD_PHYSMAP_OF=y
# CONFIG_BLK_DEV is not set
# CONFIG_INPUT_KEYBOARD is not set
# CONFIG_INPUT_MOUSE is not set
# CONFIG_SERIO is not set
# CONFIG_VT is not set
# CONFIG_UNIX98_PTYS is not set
# CONFIG_LEGACY_PTYS is not set
# CONFIG_LEGACY_TIOCSTI is not set
# CONFIG_LDISC_AUTOLOAD is not set
CONFIG_SERIAL_8250=y
# CONFIG_SERIAL_8250_DEPRECATED_OPTIONS is not set
# CONFIG_SERIAL_8250_16550A_VARIANTS is not set
CONFIG_SERIAL_8250_CONSOLE=y
CONFIG_SERIAL_8250_HPM=y
CONFIG_SERIAL_EARLYCON_RISCV_SBI=y
CONFIG_HVC_RISCV_SBI=y
CONFIG_SERIAL_DEV_BUS=y
# CONFIG_HW_RANDOM is not set
# CONFIG_DEVMEM is not set
CONFIG_POWER_RESET=y
CONFIG_POWER_RESET_SYSCON=y
CONFIG_POWER_RESET_SYSCON_POWEROFF=y
# CONFIG_HWMON is not set
# CONFIG_HID_SUPPORT is not set
# CONFIG_USB_SUPPORT is not set
# CONFIG_VIRTIO_MENU is not set
# CONFIG_VHOST_MENU is not set
CONFIG_GOLDFISH=y
# CONFIG_NVMEM is not set
# CONFIG_DNOTIFY is not set
# CONFIG_INOTIFY_USER is not set
# CONFIG_PROC_SYSCTL is not set
CONFIG_CRAMFS=y
# CONFIG_CRAMFS_BLOCKDEV is not set
CONFIG_SQUASHFS=y
CONFIG_SQUASHFS_FILE_DIRECT=y
# CONFIG_SQUASHFS_ZLIB is not set
CONFIG_SQUASHFS_LZ4=y
CONFIG_LSM="[]"
CONFIG_PRINTK_TIME=y
CONFIG_DYNAMIC_DEBUG=y
CONFIG_DEBUG_INFO_DWARF_TOOLCHAIN_DEFAULT=y
CONFIG_GDB_SCRIPTS=y
CONFIG_FRAME_WARN=2048
CONFIG_DEBUG_FS=y
CONFIG_PANIC_ON_OOPS=y
# CONFIG_FTRACE is not set
# CONFIG_RUNTIME_TESTING_MENU is not set
CONFIG_GPIO_HPMICRO=y
CONFIG_GPIOLIB=y
```

## drivers/pinctrl/hpmicro/Kconfig
```kconfig
# SPDX-License-Identifier: GPL-2.0-only

config PINCTRL_HPMICRO
	tristate "Pinctrl driver for the HPMicro SoC"
	depends on ARCH_HPMICRO || COMPILE_TEST
	select GENERIC_PINCTRL_GROUPS
	select GENERIC_PINMUX_FUNCTIONS
	select GENERIC_PINCONF
	select GPIOLIB
	select GPIOLIB_IRQCHIP
	select OF_GPIO
	default ARCH_HPMICRO
	help
	  Say yes here to support pin control on the HPMicro SoC.
	  This also provides an interface to the GPIO pins not used by other
	  peripherals supporting inputs, outputs, configuring pull-up/pull-down
	  and interrupts on input changes.
```
